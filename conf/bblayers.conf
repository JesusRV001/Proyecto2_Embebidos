## conf/bblayers.conf
```bitbake
# POKY_BBLAYERS_CONF_VERSION is increased each time build/conf/bblayers.conf
# changes incompatibly
POKY_BBLAYERS_CONF_VERSION = "2"

BBPATH = "${TOPDIR}"
BBFILES ?= ""

BBLAYERS ?= " \
  /media/tec-mb/Yocto/Pi/poky/meta \
  /media/tec-mb/Yocto/Pi/poky/meta-poky \
  /media/tec-mb/Yocto/Pi/poky/meta-yocto-bsp \
  /media/tec-mb/Yocto/Pi/poky/meta-openembedded/meta-oe \
  /media/tec-mb/Yocto/Pi/poky/meta-openembedded/meta-python \
  /media/tec-mb/Yocto/Pi/poky/meta-openembedded/meta-multimedia \
  /media/tec-mb/Yocto/Pi/poky/meta-openembedded/meta-networking \
  /media/tec-mb/Yocto/Pi/poky/meta-raspberrypi \
  /media/tec-mb/Yocto/Pi/poky/meta-tensorflow-lite \
  /media/tec-mb/Yocto/Pi/poky/meta-mylayer \
  "
```
